## boards/microchip/mega_can/Kconfig.mega_can
```kconfig
# Copyright (c) 2026
# SPDX-License-Identifier: Apache-2.0

config BOARD_MEGA_CAN
	select SOC_PIC32CZ8110CA80208
```

## boards/microchip/mega_can/board.yml
```yaml
# Copyright (c) 2026
# SPDX-License-Identifier: Apache-2.0

board:
  name: mega_can
  full_name: MEGA-CAN (PIC32CZ CA80 custom)
  vendor: microchip
  socs:
    - name: pic32cz8110ca80208
```

## module/drivers/ethernet/Kconfig
```kconfig
# Copyright (c) 2026 Microchip Technology Inc.
# Copyright (c) 2026 UMass Robotics Club
# SPDX-License-Identifier: Apache-2.0

# Port of drivers/ethernet/Kconfig.mchp (ETH_MCHP_GMAC_G1) to the PIC32CZ CA
# "ETH" block. The RX/thread options keep the upstream names on purpose so the
# driver source stays diffable against eth_mchp_gmac_g1.c.

menuconfig ETH_MCHP_PIC32CZ
	bool "Microchip PIC32CZ CA ETH (GMAC) driver"
	default y
	depends on ETH_DRIVER
	depends on NET_BUF_FIXED_DATA_SIZE
	depends on DT_HAS_MICROCHIP_PIC32CZ_ETH_ENABLED
	select PINCTRL
	select GPIO
	select NET_CHECKSUM_OFFLOAD_SUPPORTED if NET_L2_ETHERNET
	help
	  Ethernet driver for the PIC32CZ CA8x/CA9x ETH peripheral (Cadence GEM
	  core behind a small wrapper), with GMII (1000 Mbit/s) and MII
	  (10/100) support.

if ETH_MCHP_PIC32CZ

config ETH_MCHP_BUF_RX_COUNT
	int "Network RX buffers preallocated by the ETH driver"
	default 12
	help
	  Number of network buffers permanently owned by the driver for the
	  receive DMA. Must fit at least one full Ethernet frame.

config ETH_MCHP_RX_THREAD_STACK_SIZE
	int "RX thread stack size"
	default 1600

config ETH_MCHP_RX_THREAD_PRIORITY
	int "RX thread priority"
	default 2

config ETH_MCHP_PIC32CZ_PHY_STRAP_INIT_PRIORITY
	int "PHY strap/reset init priority"
	default 50
	help
	  POST_KERNEL priority of the hook that resets the PHY with its strap
	  pins set. Must run after GPIO and before MDIO/PHY/ETH (default 60).

endif # ETH_MCHP_PIC32CZ
```

## module/dts/bindings/ethernet/microchip,pic32cz-eth.yaml
```yaml
# Copyright (c) 2026 Microchip Technology Inc.
# Copyright (c) 2026 UMass Robotics Club
# SPDX-License-Identifier: Apache-2.0

title: Microchip PIC32CZ CA ETH (GMAC) Ethernet controller

description: |
  PIC32CZ CA8x/CA9x ETH peripheral: a Cadence GEM MAC core (same core as the
  "microchip,gmac-g1-eth" parts, at offset 0x1000) behind a wrapper with
  CTRLA (enable/reset) and CTRLB (GMII select, gigabit clock request).

  In GMII mode the transmit clock changes direction with link speed: at
  1000 Mbit/s the MAC drives GTXCK (125 MHz, GCLK channel 54), at 10/100 the
  PHY drives TX_CLK into the MAC. Boards that share one MAC pin between the
  two through an analog switch describe the switch with txclk-sel-gpios and
  provide "mii" and "gmii" pinctrl states for that pin.

compatible: "microchip,pic32cz-eth"

include:
  - name: ethernet-controller.yaml
  - name: pinctrl-device.yaml

properties:
  reg:
    required: true

  interrupts:
    required: true

  phy-handle:
    required: true

  num-queues:
    type: int
    required: true
    description: |
      Number of hardware TX/RX queues used. Only 1 is supported for now.

  phy-connection-type:
    default: "gmii"

  clocks:
    type: phandle-array

  txclk-sel-gpios:
    type: phandle-array
    description: |
      Select line of an analog switch that connects the PHY's MII TX_CLK
      output to the MAC's transmit clock pin. Active = connected (10/100).
      Driven inactive before the MAC drives GTXCK (1000).

  phy-reset-gpios:
    type: phandle-array
    description: |
      PHY reset line. Used by the strap hook, before the PHY driver runs.

  phy-strap-gpios:
    type: phandle-array
    description: |
      PHY strap pins that have no resistor on the board. While the PHY is
      held in reset, each is given an MCU pull (not driven) to the level in
      phy-strap-values; pulls are removed after reset is released.

  phy-strap-values:
    type: array
    description: |
      One entry (0 or 1) per phy-strap-gpios entry.
```
